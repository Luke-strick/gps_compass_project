## build/Kconfig/arch/Kconfig
```kconfig
# Load Zephyr Arch Kconfig descriptions.
osource "/home/luke/zephyrproject/zephyr/arch/rx/Kconfig"
osource "/home/luke/zephyrproject/zephyr/arch/x86/Kconfig"
osource "/home/luke/zephyrproject/zephyr/arch/xtensa/Kconfig"
osource "/home/luke/zephyrproject/zephyr/arch/sparc/Kconfig"
osource "/home/luke/zephyrproject/zephyr/arch/riscv/Kconfig"
osource "/home/luke/zephyrproject/zephyr/arch/posix/Kconfig"
osource "/home/luke/zephyrproject/zephyr/arch/mips/Kconfig"
osource "/home/luke/zephyrproject/zephyr/arch/arm64/Kconfig"
osource "/home/luke/zephyrproject/zephyr/arch/arm/Kconfig"
osource "/home/luke/zephyrproject/zephyr/arch/arc/Kconfig"
```

## build/Kconfig/boards/Kconfig.defconfig
```kconfig
# Load Zephyr board defconfig descriptions.
osource "/home/luke/zephyrproject/zephyr/boards/st/nucleo_l432kc/Kconfig.defconfig"
```

## build/primary/Kconfig/boards/Kconfig
```kconfig
# Load Zephyr board Kconfig descriptions.
osource "/home/luke/zephyrproject/zephyr/boards/st/nucleo_l432kc/Kconfig"
```

## build/primary/Kconfig/boards/Kconfig.nucleo_l432kc
```kconfig
# Load board Kconfig descriptions.
osource "/home/luke/zephyrproject/zephyr/boards/st/nucleo_l432kc/Kconfig.nucleo_l432kc"
```
